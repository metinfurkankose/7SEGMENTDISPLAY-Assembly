#include		<P16F877A.INC>
__config		H'3F31'

D1			EQU		0X0027
D2			EQU		0X0028
D3			EQU		0X0029

ORG				0X0000
GOTO			AYAR

ORG				0X0004
GOTO			KESME

ORG				0X0009
GOTO			MAIN

KESME
	RETFIE

AYAR
	BSF				STATUS,RP0
	CLRF			TRISB
	CLRF			TRISC
	BCF				STATUS,RP0
	GOTO			MAIN
	
MAIN
	LOOP
	MOVLW			B'01000000'
	MOVWF			PORTB
	MOVLW			B'00000110'
	MOVWF			PORTC
	CALL			GECIKME
	MOVLW			B'00001000'
	MOVWF			PORTB
	MOVLW			B'00001001'
	MOVWF			PORTC
	CALL			GECIKME
	GOTO			LOOP

GECIKME
	MOVLW			0x08
	MOVWF			D1
	MOVLW			0x2F
	MOVWF			D2
	MOVLW			0x03
	MOVWF			D3
	GECIK
		DECFSZ			D1,F
		GOTO			$+2
		DECFSZ			D2,F
		GOTO			$+2
		DECFSZ			D3,F
		GOTO			GECIK
		GOTO			$+1
		NOP
		RETURN

END